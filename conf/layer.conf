## conf/layer.conf
```bitbake
# We have a conf and classes directory, add to BBPATH
BBPATH .= ":${LAYERDIR}"

# We have recipes-* directories, add to BBFILES
BBFILES += "${LAYERDIR}/recipes-*/*/*.bb \
            ${LAYERDIR}/recipes-*/*/*.bbappend"

BBFILE_COLLECTIONS += "meta-agl-gsoc-quiz-2025"
BBFILE_PATTERN_meta-agl-gsoc-quiz-2025 = "^${LAYERDIR}/"
BBFILE_PRIORITY_meta-agl-gsoc-quiz-2025 = "6"

LAYERDEPENDS_meta-agl-gsoc-quiz-2025 = "core"
LAYERSERIES_COMPAT_meta-agl-gsoc-quiz-2025 = "scarthgap"
```
